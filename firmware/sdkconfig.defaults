## firmware/sdkconfig.defaults.p4-audio86-real-guest
```kconfig
# Headless real-i286 PC-9801-86 audio profile.
CONFIG_ESP_MAIN_TASK_STACK_SIZE=6144
CONFIG_ESP_DEFAULT_CPU_FREQ_MHZ_360=y
CONFIG_ESP_DEFAULT_CPU_FREQ_MHZ=360
CONFIG_FREERTOS_HZ=100
CONFIG_SPIRAM_SPEED_200M=y
CONFIG_SPIRAM_SPEED=200
# CONFIG_PM_ENABLE is not set
```

## hardware/bringup/esp32-p4/p4-nano/display/main/Kconfig.projbuild
```kconfig
menu "P4-NANO display diagnostic"

config P4_NANO_DISPLAY_RUN_HARDWARE_TEST
    bool "Run the physical MIPI-DSI display test"
    default n
    help
        Enable only after the LCD FPC, separate display power, and the
        mechanical protection bracket have been checked with power off.
        When disabled, the application performs only the offline framebuffer
        self-test and does not access DSI, JD9365, or the display I2C bus.

endmenu
```

## hardware/bringup/esp32-p4/p4-nano/sdmmc/sdkconfig.defaults
```kconfig
CONFIG_IDF_TARGET="esp32p4"
CONFIG_ESP32P4_SELECTS_REV_LESS_V3=y
CONFIG_ESP32P4_REV_MIN_100=y
CONFIG_ESPTOOLPY_FLASHSIZE_16MB=y
CONFIG_ESP_CONSOLE_UART_DEFAULT=y
CONFIG_ESP_CONSOLE_SECONDARY_NONE=y
CONFIG_FATFS_VOLUME_COUNT=2
```
